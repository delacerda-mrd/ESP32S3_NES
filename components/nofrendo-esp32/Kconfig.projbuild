## components/nofrendo-esp32/Kconfig.projbuild
```kconfig
menu "Nofrendo ESP32-specific configuration"

config SOUND_ENA
	bool "Audio output (ES8311 codec)"
	default y
	help
		Enable ES8311 codec + I2S audio output and the FM8002E amplifier.
		Pins are fixed by the ES3C28P board.

endmenu
```
